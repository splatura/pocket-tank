## firmware/main/Kconfig.projbuild
```kconfig
menu "pocket-tank"
    config POCKET_TANK_DISPLAY_SH8601
        bool "Drive the Waveshare 1.8in AMOLED (SH8601 / CO5300 over QSPI)"
        default n
        depends on !POCKET_TANK_LCD40
        help
            Enable for the real board. Off = stub display port (QEMU / compile-only).
    config POCKET_TANK_ROUND
        bool "The ROUND build: a 466 px bowl for the Waveshare ESP32-S3-Touch-AMOLED-1.75C"
        default n
        help
            The tank's world is compiled in: off = the 448x368 rectangle (the
            1.8 board; on a 1.75C that image still runs, the frame shown inside
            the circle). On = TANK_ROUND, the bowl that fills the round glass;
            that image shows nothing on a 1.8. Build it with
            SDKCONFIG_DEFAULTS="sdkconfig.defaults;sdkconfig.round" into its
            own build directory and sdkconfig (docs/board-amoled-1.75c.md).
    config POCKET_TANK_WATCH
        bool "The WATCH build: a 410x502 PORTRAIT tank for the Waveshare ESP32-S3-Touch-AMOLED-2.06"
        default n
        depends on !POCKET_TANK_ROUND
        help
            On = TANK_WATCH: a tall tank the way a watch is worn, with the
            round corners of its glass; that image shows nothing on the
            other boards. Off, the 448x368 rectangle image still runs on a
            watch, on its side and centred in the glass. Build it with
            SDKCONFIG_DEFAULTS="sdkconfig.defaults;sdkconfig.watch" into its
            own build directory and sdkconfig (docs/board-amoled-2.06-watch.md).
    config POCKET_TANK_LCD40
        bool "The FNK0104S build: a 480x320 tank for the Freenove FNK0104S (4.0in ST7796S SPI LCD)"
        default n
        depends on !POCKET_TANK_ROUND && !POCKET_TANK_WATCH
        help
            On = TANK_LCD40 (docs/board-fnk0104s.md). Build it with
            SDKCONFIG_DEFAULTS="sdkconfig.defaults;sdkconfig.lcd40" into its own
            build directory and sdkconfig. Its image shows nothing on the other boards.
    config POCKET_TANK_DISPLAY_ST7796
        bool "Drive the FNK0104S's ST7796S over 4-wire SPI"
        default n
        depends on POCKET_TANK_LCD40 && !POCKET_TANK_DISPLAY_SH8601
        help
            The ST7796S 320x480 IPS panel over 4-wire SPI, driven landscape with a PWM
            backlight (display_port_st7796.c; docs/board-fnk0104s.md). Off = stub display port.
    config POCKET_TANK_LCD40_SPI_MHZ
        int "ST7796S SPI clock (MHz): 40 is the release default; 80 only after the bench soak (docs/board-fnk0104s.md)"
        default 40
        range 10 80
        depends on POCKET_TANK_DISPLAY_ST7796
    config POCKET_TANK_TOUCH_FT3168
        bool "Read the FT3168 capacitive touch (taps / holds)"
        default n
    config POCKET_TANK_AUDIO_ES8311
        bool "Play the sound bank through the ES8311 codec + NS4150B amp (I2S)"
        default n
        help
            Enable for the real board (docs/AUDIO.md). Off = stub audio port: cues compile, nothing plays.
    config POCKET_TANK_NO_PIE
        bool "Disable the PIE SIMD inference kernel (scalar dot products)"
        default n
        help
            Enable for a QEMU build if the emulator lacks ESP32-S3 PIE support.
endmenu
```
